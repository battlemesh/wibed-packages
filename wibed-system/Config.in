## wibed-system/Config.in
```kconfig
# Wibed-packages Configuration
menu "Wibed node configuration"

    config WIBED_SYSTEM_SERVER
        string
        prompt "Controller URL"
        default "http://wibed.confine-project.eu/"
	select KMOD_BATMAN_ADV_BATMAN_V
        help
            Specify the URL of the WiBed Controller Server where the nodes will connect.
            The default URL is the CONFINE WiBed Controller.

    config WIBED_SYSTEM_TESTBED
        string
        prompt "Testbed name"
        default "wibed"
        help
            Specify the testbed name. This is used to identify a group of routers in a
            specific location (e.g. WiBed-LabDeployment-1).

    config WIBED_SYSTEM_ROOT_PASSWORD
        string
        prompt "Node root password"
        default "wibed"
        help
            Specify the root password for the node. Setting a password will, during
            the first boot, disable telnet and enable SSH login.

    menu "Management Network Configuration"

        config WIBED_SYSTEM_GW
            bool "Gateway node"
            default n
            help
                Choose whether the node will be a gateway node. Gateway nodes are connected
                to an Internet up-link and share the connection among the rest of nodes over
                the mesh management network. Gateway nodes shouldn't be used for experiments.

        config WIBED_SYSTEM_MGMT_SSID
            string
            prompt "802.11s management network SSID"
            default "wibed"
            help
                Specify the SSID of the 802.11s mesh management network. All nodes in the
                same testbed must have the same 802.11s mesh SSID to be able to create the
                management network.

        config WIBED_SYSTEM_MGMT_BSSID
            string
            prompt "Ad-Hoc management network BSSID"
            default "02:C0:FF:EE:C0:DE"
            help
                Specify the BSSID of the Ad-Hoc management mesh network. All nodes in the
                same testbed must have the same Ad-Hoc BSSID to be able to create the
                management network.

        config WIBED_SYSTEM_MGMT_CHANNEL2
            string
            prompt "Ad-Hoc management network 2.4 GHz Channels"
            default "6"
            help
                Specify the 2.4 GHz channels to be used in the Ad-Hoc management mesh network.
                They should be separated by spaces and will be assigned to wireless interfaces in the
                specified order

        config WIBED_SYSTEM_MGMT_CHANNEL5
            string
            prompt "Ad-Hoc management network 5 GHz Channels"
            default "40+"
            help
                Specify the 5 GHz channels to be used in the Ad-Hoc management mesh network.
                They should be separated by spaces and will be assigned to wireless interfaces in the
                specified order


    endmenu

endmenu
```
